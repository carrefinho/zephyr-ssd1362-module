## Kconfig
```kconfig
# Copyright (c) 2024 Lukasz Hawrylko
# SPDX-License-Identifier: Apache-2.0

rsource "drivers/Kconfig"
```

## drivers/Kconfig
```kconfig
# Copyright (c) 2024 Lukasz Hawrylko
# SPDX-License-Identifier: Apache-2.0

rsource "display/Kconfig"
```

## drivers/display/Kconfig.ssd1362
```kconfig
config SSD1362
	bool "SSD1362 display driver"
	default y
	depends on DT_HAS_SOLOMON_SSD1362_ENABLED
	select MIPI_DBI
	help
	  Enable driver for SSD1362 display controller.

if SSD1362

config SSD1362_DEFAULT_GREYSCALE
	bool "SSD1362 default mode is greyscale"
	help
	  Sets greyscale mode as default mode.

endif # SSD1362
```

## dts/bindings/display/solomon,ssd1362.yaml
```yaml
description: Solomon SSD1362 256x64 16 gray level OLED display controller

compatible: "solomon,ssd1362"

include: [mipi-dbi-spi-device.yaml, display-controller.yaml]

properties:
  column-offset:
    type: int
    default: 0
    description: First visible column number.

  row-offset:
    type: int
    default: 0
    description: Display offset (vertical shift) from 0 to 63.

  start-line:
    type: int
    default: 0
    description: Starting line address of display RAM (0-63).

  mux-ratio:
    type: int
    default: 64
    description: Multiplex ratio from 16 to 64. Typically height.

  remap-columns:
    type: boolean
    description: Reverse the column order (flip horizontally).

  remap-nibble:
    type: boolean
    description: Reverse nibble order within each byte.

  remap-row-first:
    type: boolean
    description: Set scan direction to vertical first (swap rows/columns).

  remap-rows:
    type: boolean
    description: Reverse the row order (flip vertically).

  remap-com-odd-even-split:
    type: boolean
    description: Odd even split of COM pins.

  remap-com-dual:
    type: boolean
    description: SEG left/right remap.

  segments-per-pixel:
    type: int
    default: 1
    enum:
      - 1
      - 2
    description: |
      Map multiple adjacent segments to one pixel.
      Some displays connect two adjacent pixel drivers to each physical pixel.
      By setting this to 2, the driver will repeat each pixel.

  contrast:
    type: int
    default: 0x9F
    description: Initial contrast setting (0-255).

  inversion-on:
    type: boolean
    description: Invert display colors.

  iref-external:
    type: boolean
    description: Use external IREF current reference instead of internal.
```
